/*@@var:*/
variables
{
    int edgeUp = 0;
    message Botschaft123 msg123;
}
/*@@end*/

/*@@envVar:evPanel:*/
on envVar evPanel
{
    if (getValue(this))
        output(msg123);
}
/*@@end*/

