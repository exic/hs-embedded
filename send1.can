/*@@var:*/
variables
{
    message Botschaft123 msg123;
}
/*@@end*/

/*@@key:'s':*/
on key 's'
{
    output(msg123);
}
/*@@end*/

