VERSION ""

NS_ :

BS_:

BU_:

BO_ 66 Botschaft42: 2 Vector__XXX
 SG_ NeuesSignal_4 : 8|8@1- (1,0) [0|0] "" Vector__XXX
 SG_ NeuesSignal_3 : 0|8@1- (1,0) [0|0] "" Vector__XXX

BO_ 291 Botschaft123: 2 Vector__XXX
 SG_ NeuesSignal_2 : 8|8@1- (1,0) [0|0] "" Vector__XXX
 SG_ NeuesSignal_1 : 0|8@1- (1,0) [0|0] "" Vector__XXX
