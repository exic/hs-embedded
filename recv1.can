/*@@var:*/
variables
{
    int counter = 0;
    message Botschaft42 msg42;
}
/*@@end*/

/*@@msg:CAN1.database::Botschaft123 (0x123):*/
on message Botschaft123
{
    counter = counter + 1;
    output(msg42);
    if (counter % 10 == 0) {
        write("Current count: %i", counter);
    }
}
/*@@end*/

/*@@key:'a':*/
on key 'a'
{
    write("jau");
    //output(Botschaft123);
}
/*@@end*/

