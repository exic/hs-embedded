/*@@var:*/
variables
{
    int counter;
    message m42 42;
}
/*@@end*/

/*@@msg:0x123:*/
on message 0x123
{
    counter++;
    //write("hmm");
    output(m42);
    if (counter % 10 == 0) write("%d messages counted.", counter);
}
/*@@end*/

/*@@key:'a':*/
on key 'a'
{
    write("test");
    output(m42);
}
/*@@end*/

/*@@msg:0x42:*/
on message 0x42
{
    write("blah!");
}
/*@@end*/

