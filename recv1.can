/*@@var:*/
variables
{
    int counter = 0;
    message Botschaft42 msg42;
    mstimer watchdog;
}
/*@@end*/

/*@@msg:CAN1.database::Botschaft123 (0x123):*/
on message Botschaft123
{
    counter = counter + 1;
    output(msg42);
    write("Got 0x123");
    setTimer(watchdog, 2000);
    if (counter % 10 == 0) {
        write("Current count: %i", counter);
    }
}
/*@@end*/

/*@@key:'a':*/
on key 'a'
{
    write("jau");
    //output(Botschaft123);
}
/*@@end*/

/*@@timer:<newTimer>:*/
on timer watchdog
{
    write("Warn: Got no message 0x123!");
    setTimer(watchdog, 2000);
}
/*@@end*/

/*@@startStart:Start:*/
on start
{
    setTimer(watchdog, 2000);
}
/*@@end*/

